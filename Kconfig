## Kconfig
```kconfig
mainmenu "OpenExyBootchain Configuration"

source "boards/Kconfig"
source "platforms/Kconfig"
```

## boards/Kconfig
```kconfig
choice
	prompt "Board Select"

config BOARD_A3Y17LTE
	bool "Samsung Galaxy A3 (2017) - A3Y17LTE"
        select SOC_EXYNOS7870

config BOARD_JACKPOTLTE
	bool "Samsung Galaxy A8 (2018) - JACKPOTLTE"
        select SOC_EXYNOS7885

endchoice

config BL1_FOOTER_MODEL_ID1
	string
	help
	  This option should contain the first part of the MODEL ID in BL1 footer.

config BL31_PUBKEY_FILE
	string "BL31 Public Key file"
	help
	  Path to public key for next stage after BL1. Will be embedded in BL1 footer.


if BOARD_A3Y17LTE

config BL1_FOOTER_MODEL_ID1
	default "0x20"

config BL31_PUBKEY_FILE
	default "blobs/a3y17lte_bl31_pubkey"

endif

if BOARD_JACKPOTLTE

config BL1_FOOTER_MODEL_ID1
	default "0x4E"

config BL31_PUBKEY_FILE
	default "blobs/jackpotlte_bl31_pubkey"

endif
```

## platforms/Kconfig
```kconfig
config SOC_EXYNOS7870
	bool

config SOC_EXYNOS7885
	bool

config SOC_EXYNOS9610
	bool

config SOC_EXYNOS9830
	bool

config BL1_LOAD_ADDRESS
	hex
	help
	  This option should contain the address where BL1 will be loaded to.

config BL31_LOAD_ADDRESS
	hex
	help
	  This option should contain the address where BL31 will be loaded to.

config IRAM_END_ADDRESS
	hex
	help
	  This option should contain the end address of iRAM.

if SOC_EXYNOS7870

config BL1_LOAD_ADDRESS
	default 0x02021800

config BL31_LOAD_ADDRESS
	default 0x02024000

config IRAM_END_ADDRESS
	default 0x0206D000

endif

if SOC_EXYNOS7885

config BL1_LOAD_ADDRESS
	default 0x02021800

config BL31_LOAD_ADDRESS
	default 0x02024000

config IRAM_END_ADDRESS
	default 0x0206D000

endif

if SOC_EXYNOS9610

config BL1_LOAD_ADDRESS
	default 0x02021800

config BL31_LOAD_ADDRESS
	default 0x02024000

config IRAM_END_ADDRESS
	default 0x0206D000

endif

if SOC_EXYNOS9830

config BL1_LOAD_ADDRESS
	default 0x02022000

config BL31_LOAD_ADDRESS
	default 0x02026000

config IRAM_END_ADDRESS
	default 0x02071000

endif
```
